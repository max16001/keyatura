## boards/shields/keyatura/Kconfig.defconfig
```kconfig
if SHIELD_KEYATURA_RIGHT

config ZMK_KEYBOARD_NAME
    default "Keyatura"

config ZMK_SPLIT_ROLE_CENTRAL
    default y

endif

if SHIELD_KEYATURA_LEFT || SHIELD_KEYATURA_RIGHT

config ZMK_SPLIT
    default y

endif
```

## boards/shields/keyatura/Kconfig.shield
```kconfig
config SHIELD_KEYATURA_LEFT
    def_bool $(shields_list_contains,keyatura_left)

config SHIELD_KEYATURA_RIGHT
    def_bool $(shields_list_contains,keyatura_right)

config SHIELD_KEYATURA_DONGLE
    def_bool $(shields_list_contains,keyatura_shield)
```

## config/west.yml
```yaml
manifest:
  remotes:
    - name: inorichi
      url-base: https://github.com/inorichi
  projects:
    - name: zmk-pmw3610-driver
      remote: inorichi
      revision: main
  self:
    path: config
```
